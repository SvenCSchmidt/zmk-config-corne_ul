## config/boards/shields/corne/Kconfig.defconfig
```kconfig
if SHIELD_CORNE_LEFT

config ZMK_KEYBOARD_NAME
    default "corne-ul"

config ZMK_SPLIT_ROLE_CENTRAL
    default y

endif

if SHIELD_CORNE_RIGHT

config ZMK_KEYBOARD_NAME
    default "corne-ul-noBT"

config ZMK_SPLIT_ROLE_CENTRAL
    default n

endif

if SHIELD_CORNE_LEFT || SHIELD_CORNE_RIGHT

config ZMK_SPLIT
    default y

endif
```
